## lib/utils/mpxy/Kconfig
```kconfig
# SPDX-License-Identifier: BSD-2-Clause

menu "MPXY Device Support"

config FDT_MPXY
	bool "FDT based MPXY drivers"
	depends on FDT
	default n

config FDT_MPXY_BRIDGE
	bool "MPXY bridge driver for interdomain communication"
	depends on FDT_MPXY_RPMI
	default n

config FDT_MPXY_RPMI_TEE
	bool "MPXY driver for the RPMI TEE framework"
	depends on FDT_MPXY_BRIDGE
	default n
	help
	  Enable RPMI TEE service channels configured by the trusted device tree.
	  These channels provide endpoint discovery, synchronous TEE calls,
	  memory parcel operations and signal buses. Requests requiring TEE
	  execution are forwarded through the MPXY domain bridge.

config FDT_MPXY_RPMI_TEE_TEST_SHARED_RAM
	bool "TEST: RPMI TEE parcels over statically shared RAM"
	depends on FDT_MPXY_RPMI_TEE
	default n
	help
	  Enable parcel protocol testing without dynamic memory protection.
	  Both endpoint domains must already have supervisor read/write access
	  to the shared normal RAM. Keep private TEE and firmware RAM protected
	  through the trusted domain configuration.

	  The TEE service requires this option until enforcement is implemented.
	  Domain policy must exclude MMIO and private RAM from shared access.

	  Parcel identities, overlaps and lifecycle are checked, but access
	  is not narrowed or revoked on acceptance, release or reclamation.
	  Executable parcels are unsupported. This is for functional bring-up
	  only and must not be used to validate isolation or revocation.

config FDT_MPXY_RPMI
	bool "FDT based MPXY RPMI drivers"
	depends on FDT_MAILBOX && FDT_MPXY
	default n

if FDT_MPXY_RPMI

config FDT_MPXY_RPMI_CLOCK
	bool "MPXY driver for RPMI clock service group"
	default n

config FDT_MPXY_RPMI_LOGGING
	bool "MPXY driver for RPMI logging service group"
	default n

config FDT_MPXY_RPMI_SYSMSI
	bool "MPXY driver for RPMI system MSI service group"
	default n

config FDT_MPXY_RPMI_VOLTAGE
	bool "MPXY driver for RPMI voltage service group"
	default n

config FDT_MPXY_RPMI_DEVICE_POWER
	bool "MPXY driver for RPMI device power service group"
	default n

config FDT_MPXY_RPMI_PERFORMANCE
	bool "MPXY driver for RPMI performance service group"
	default n

config FDT_MPXY_RPMI_MM
	bool "MPXY driver for RPMI MM service group"
	default n

endif

endmenu
```
